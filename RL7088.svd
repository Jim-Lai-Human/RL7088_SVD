# RL7088 register map
Vendor: Realtek Semiconductor Corp.; Series: RL7088 Series; File version: 1.00
Real-M300 Arm v8-M Instruction Processor
CPU: ARMV8MML r0p0, little endian, MPU, FPU, VTOR, 3 interrupt priority bits, 8 SAU regions
Registers are 32-bit, read-write, reset 0x0 unless marked. A register's access mark holds for its fields unless they carry their own. Offsets are from the block's base; lines under a group give offsets from that group; [hi:lo] are bit positions; {n}, {i} and the like mark numbered series; 'fields as' and 'values as' point back to an identical list; <NAME> marks a mode.

## Memory map
0x20200000 BRAM size 0x100 — Battery RAM
0x40000000 SPIC size 0x1000 — SPIC Controller
0x40001000 SPIC1 size 0x1000
0x40002000 SHA3 size 0x1000 — Lalu SHA3 Engine
0x40002000 DMA size 0x1000 — DMA Controller
0x40003000 I3C0 size 0x1000 — I3C Controller
0x40004000 I3C1 size 0x1000
0x4000C014 PWRBTN size 0x2C — Power Button Over WDT Controller
0x4000F930 LEDDBG0 size 0x14 — LED Debug 0
0x4000F944 LEDDBG1 size 0x14
0x40010830 T1HZ size 0x10 — Timer 1 Hz
0x40010900 EFUSE size 0x18 — eFuse Controller
0x40041000 SHA2DMA size 0x1000 — Lalu SHA2 DMA Controller
0x40043000 AES size 0x1000 — Lalu AES Engine
0x40044000 AES2 size 0x1000
0x40044000 AESDMA size 0x1000
0x40050000 LALU size 0x40000 — LALU 1
0x40080000 PKE size 0x40000 — Lalu Public Key Engine
0x40090000 LALU2 size 0x40000
0x40091000 IOPAD size 0x20 — I/O Pad Controller
0x400A021C PMPORT0 size 0x100 — PM Port Controller
0x400A0238 PMPORT1 size 0x100
0x400A0254 PMPORT2 size 0x100
0x400A0270 PMPORT3 size 0x100
0x400A02C0 DIO0 size 0x8 — Dedicated I/O Controller
0x400A02C8 DIO1 size 0x8
0x400B1400 MONOTONIC size 0x20 — Monotonic Counter
0x400B1600 MBX size 0xD0 — Mailbox Controller
0x400C0000 PQC size 0x40000 — Lalu Post Quantum Cryptography Engine
0x400D0000 PUF size 0x2000 — Crypto PUF
0x40100000 SYSTEM size 0x400 — System Controller
0x40220000 ESPI size 0x1000 — eSPI Controller
0x40221000 EMI0 size 0x14 — EMI Controller
0x40221020 EMI1 size 0x14
0x40221040 EMI2 size 0x14
0x40221060 EMI3 size 0x14
0x40221080 EMI4 size 0x14
0x402210A0 EMI5 size 0x14
0x402210C0 EMI6 size 0x14
0x402210E0 EMI7 size 0x14
0x40221200 PORT80 size 0x100 — PORT80 Controller
0x40221400 ACPI size 0x100 — ACPI Controller
0x40221700 KBC size 0x100 — KBC Controller
0x40221900 PECI size 0x100 — PECI Controller
0x40221B00 SPIM size 0x100 — SPIM Controller
0x40222000 SPIS size 0x500 — SPIS Controller
0x40230000 GPIO size 0x20000 — GPIO Controller
0x40250000 I2C0 size 0x200 — I2C Controller
{0x40250000+0x200*n} I2C{n} size 0x200 (n=1..10)
0x40251600 UART size 0x100 — UART Controller
0x40251700 UART1 size 0x100
0x40251800 UART2 size 0x100
0x40251900 ADC size 0x100 — 12-bit ADC Controller
0x40251A00 LEDSTP size 0x100 — LED Strip Controller
0x40251C00 I2CDBGCTRL size 0x100 — I2C Debug Controller
0x40251F00 TACHO0 size 0x100 — Tachometer Controller
{0x40251F00+0x100*n} TACHO{n} size 0x100 (n=1..13)
0x40252D00 LED size 0x100
0x40252E00 LED2 size 0x100
0x40252F00 LED3 size 0x100
0x40253000 LED4 size 0x100
0x40253100 TMR0 size 0x100
0x40253200 TMR1 size 0x100
0x40253300 TMR2 size 0x100
0x40253400 TMR3 size 0x100
0x40253500 TMR4 size 0x100
0x40253600 TMR5 size 0x100
0x40253700 SLWTMR0 size 0x100 — 32-bit SlowTimer Controller
0x40253800 SLWTMR1 size 0x100
0x40253900 SLWTMR2 size 0x100
0x40253A00 SLWTMR3 size 0x100
0x40253B00 RTMR size 0x100
0x40253C00 RTC size 0x100 — RTC Controller
0x40253D00 PWMLED0 size 0x100 — PWMLED Controller
0x40253E00 PWMLED1 size 0x100
0x40253F00 WDT size 0x100 — WDT Controller
0x40254000 CEC size 0x100 — CEC Controller
0x40254100 CEC1 size 0x100
0x40254200 KBM size 0x100 — Keyboard Matrix Controller
0x40254300 PS2 size 0x100 — PS2 Controller
0x40254400 PS2_2 size 0x100
0x40254500 PWM0 size 0x100 — PWM Controller
{0x40254500+0x100*n} PWM{n} size 0x100 (n=1..13)
0x40255300 LPT size 0x100
0x40255400 MICROCNT size 0x100 — Micro Counter Controller
0x40255600 TRAM size 0x100 — Turbo memory compare
0x40255700 PS2_3 size 0x100
0x40264000 PUFOTP size 0x1000
0x50000000 USBOTG1 size 0x40000
0x50040000 USBOTG2 size 0x40000

## Interrupts
0 GPIOA (GPIO) — GPIO Group A [7:0] Interrupt
1 GPIOB (GPIO) — GPIO Group B [15:8] Interrupt
2 GPIOC (GPIO) — GPIO Group C [23:16] Interrupt
3 GPIOD (GPIO) — GPIO Group D [31:24] Interrupt
4 GPIOE (GPIO) — GPIO Group E [39:32] Interrupt
5 GPIOF (GPIO) — GPIO Group F [47:40] Interrupt
6 GPIOG (GPIO) — GPIO Group G [55:48] Interrupt
7 GPIOH (GPIO) — GPIO Group H [63:56] Interrupt
8 GPIOI (GPIO) — GPIO Group I [71:64] Interrupt
9 GPIOJ (GPIO) — GPIO Group J [79:72] Interrupt
10 GPIOK (GPIO) — GPIO Group K [87:80] Interrupt
10 SLWTMR2 — SLOWTIMER2 Interrupt
11 GPIOL (GPIO) — GPIO Group L [95:88] Interrupt
11 SLWTMR3 — SLOWTIMER3 Interrupt
12 GPIOM (GPIO) — GPIO Group M [103:96] Interrupt
13 GPION (GPIO) — GPIO Group N [111:104] Interrupt
14 GPIOO (GPIO) — GPIO Group O [119:112] Interrupt
15 GPIOP (GPIO) — GPIO Group P [127:120] Interrupt
16 GPIOQ (GPIO) — GPIO Group Q [135:128] Interrupt
17 GPIOR (GPIO) — GPIO Group R [143:136] Interrupt
18 GPIOS (GPIO) — GPIO Group S [151:144] Interrupt
19 GPIOT (GPIO) — GPIO Group T [159:152] Interrupt
22 ERST (ESPI) — eSPI Reset Pin Interrupt
23 EPRCH (ESPI) — eSPI Peripheral Ch. Interrupt (read done / write done / write address miss)
24 EVCHIDX61 (ESPI) — eSPI Virtual Wire Ch. Index61 Interrupt
25 EVCHIDX51 (ESPI) — eSPI Virtual Wire Ch. Index51 Interrupt
26 EVCHIDX4A (ESPI) — eSPI Virtual Wire Ch. Index4A Interrupt
27 EVCHIDX47 (ESPI) — eSPI Virtual Wire Ch. Index47 Interrupt
28 EVCHIDX44 (ESPI) — eSPI Virtual Wire Ch. Index44 Interrupt
29 EVCHIDX43 (ESPI) — eSPI Virtual Wire Ch. Index43 Interrupt
30 EVCHIDX42 (ESPI) — eSPI Virtual Wire Ch. Index42 Interrupt
31 EVCHIDX41 (ESPI) — eSPI Virtual Wire Ch. Index41 Interrupt
32 EVCHIDX7 (ESPI) — eSPI Virtual Wire Ch. Index7 Interrupt
33 EVCHIDX3 (ESPI) — eSPI Virtual Wire Ch. Index3 Interrupt
34 EVCHIDX2 (ESPI) — eSPI Virtual Wire Ch. Index2 Interrupt
35 EVCH (ESPI) — eSPI Virtual Wire Ch. Interrupt
36 EOCHTX (ESPI) — eSPI OOB Ch. Tx Interrupt
37 EOCHRX (ESPI) — eSPI OOB Ch. Rx Interrupt
38 EOCHCFGEN (ESPI) — eSPI OOB Ch. Conf Enable Change Interrupt
39 EFSAFSTR (ESPI) — eSPI SAFS TR Interrupt
40 EFSAFSERASE (ESPI) — eSPI SAFS Erase Interrupt
41 EFMAFSTR (ESPI) — eSPI MAFS TR Interrupt
42 EFCHCHG (ESPI) — eSPI Flash Chanel Change Interrupt
43 ESPIRPMC (ESPI) — eSPI RPMC op2
44 KBC_IB (KBC) — KBC Input Buffer Interrupt
45 KBC_OB (KBC) — KBC Output Buffer Interrupt
46 ACPI_IB (ACPI) — ACPI Input Buffer Interrupt
47 ACPI_OB (ACPI) — ACPI Output Buffer Interrupt
48 PMPORT0_IB (PMPORT0) — PMPORT0 Input Buffer Interrupt
49 PMPORT0_OB (PMPORT0) — PMPORT0 Output Buffer Interrupt
50 PMPORT1_IB (PMPORT1) — PMPORT1 Input Buffer Interrupt
51 PMPORT1_OB (PMPORT1) — PMPORT1 Output Buffer Interrupt
52 PMPORT2_IB (PMPORT2) — PMPORT2 Input Buffer Interrupt
53 PMPORT2_OB (PMPORT2) — PMPORT2 Output Buffer Interrupt
54 PMPORT3_IB (PMPORT3) — PMPORT3 Input Buffer Interrupt
55 PMPORT3_OB (PMPORT3) — PMPORT3 Output Buffer Interrupt
56 PORT80 — PORT80 Interrupt
57 PORT81 (PORT80) — PORT81 Interrupt
58 PECI — PECI Interrupt
59 CEC — CEC Interrupt
60 CEC1 — CEC1 Interrupt
62 SPIC — SPIC Interrupt
63 SPIC1 — SPIC1 Interrupt
{n+65} I2C{n} (n=0..10) — I2C{n} Interrupt
76 PS2 — PS2 Interrupt
78 PS2_3 — PS2 3 Interrupt
79 UART — UART Interrupt
80 UART1 — UART1 Interrupt
81 UART2 — UART2 Interrupt
{n+82} TACHO{n} (n=0..13) — TACHO{n} Interrupt
165 PQC — PQC Interrupt
175 EFUSE_DMA (EFUSE) — EFUSE DMA interrupt
179 LEDSTP — LEDSTP Interrupt
181 SPIS — SPIS interrupt
196 TMR0 — TIMER0 Interrupt
197 TMR1 — TIMER1 Interrupt
198 TMR2 — TIMER2 Interrupt
199 TMR3 — TIMER3 Interrupt
200 TMR4 — TIMER4 Interrupt
201 TMR5 — TIMER5 Interrupt
202 SLWTMR0 — SLOWTIMER0 Interrupt
203 SLWTMR1 — SLOWTIMER1 Interrupt
204 RTMR — RTOSTIMER Interrupt
205 RTC — RTC Interrupt
206 I3C0 — I3C0 Interrupt
207 I3C1 — I3C1 Interrupt
208 PWRBTN — PWRBTN Interrupt
209 WDT — WDT Interrupt
210 KBM — KBM Interrupt
211 SPIM — SPIM interrupt
{n+212} EMI{n} (n=0..7) — EMI{n} Interrupt
220 MBX — MAILBOX Interrupt
221 ADC — ADC Interrupt
223 ACPR0 (ADC) — ADC Comparator 0 Interrupt
224 ACPR1 (ADC) — ADC Comparator 1 Interrupt
225 ACPR2 (ADC) — ADC Comparator 2 Interrupt
226 ACPR3 (ADC) — ADC Comparator 3 Interrupt
228 BTNTRI (PWRBTN) — PWRBTN Trigger Interrupt
234 DMA — DMA Interrupt
236 SHA3 — SHA3 Interrupt
237 AES — AES Interrupt
238 PKE — PKE Interrupt
27735 PS2_2 — PS2 2 Interrupt

## Licence text in the file
The license belong to Realtek Semiconductor Corp. All the rights reserved.
